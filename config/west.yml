## config/west.yml
```yaml
manifest:
  remotes:
    - name: zmkfirmware
      url-base: https://github.com/zmkfirmware
  projects:
    - name: zmk
      remote: zmkfirmware
      revision: 34e114876b0b11c390a56381ad16ebd13914f8d5
      import: app/west.yml
  self:
    path: config
```
